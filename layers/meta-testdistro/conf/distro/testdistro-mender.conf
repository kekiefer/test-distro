## layers/meta-testdistro/conf/distro/testdistro-mender.conf
```bitbake
require conf/distro/include/testdistro-base.inc

DISTRO = "testdistro-mender"
DISTRO_NAME = "Test Distro + Mender"
DISTRO_CODENAME = "master-mender-test"

require conf/distro/include/mender.inc

IMAGE_FSTYPES_tegra = "tegraflash mender dataimg"
IMAGE_FSTYPES_pn-tegra-minimal-initramfs_tegra = "${INITRAMFS_FSTYPES}"
IMAGE_FSTYPES_pn-td-initramfs_tegra = "${INITRAMFS_FSTYPES}"
IMAGE_FSTYPES_jetson_tx2_cboot = "tar.gz mender dataimg"

# Reserved space for tegraflash partitions, not including APP and DATA
TEGRA_FLASH_PARTITIONS_MB ?= "950"

MENDER_STORAGE_DEVICE_BASE ?= "/dev/mmcblk0p"
MENDER_STORAGE_DEVICE_BASE_secureboot ?= "/dev/mapper"
MENDER_STORAGE_TOTAL_SIZE_MB ?= "${@tegra_mender_calc_total_size(d) - int(d.getVar('TEGRA_FLASH_PARTITIONS_MB'))}"
# Reduce the rootfs size by 10% to allow for cryptfs overhead
MENDER_IMAGE_ROOTFS_SIZE_DEFAULT ?= "${@int(d.getVar('ROOTFSPART_SIZE')) * 9 // 10240}"

# Different sizes for dm-crypt layout with INSTALLER partition
TEGRA_FLASH_PARTITIONS_MB_secureboot ?= "3000"
MENDER_DATA_PART_SIZE_MB_secureboot ?= "4096"

# Use special partition layout template for secureboot
PARTITION_LAYOUT_TEMPLATE_secureboot = "flash_${MACHINE}_custom.xml"

# Mender machines need to run checks after an update
SYSTEMD_DEFAULT_TARGET = "finished-booting.target"
```

## layers/meta-testdistro/conf/layer.conf
```bitbake
BBPATH =. "${LAYERDIR}:"
# Uncomment when we add recipes
BBFILES += "${LAYERDIR}/recipes-*/*/*.bb ${LAYERDIR}/recipes-*/*/*.bbappend"

BBFILE_COLLECTIONS += "testdistro"
BBFILE_PATTERN_testdistro = "^${LAYERDIR}/"
BBFILE_PRIORITY_testdistro = "50"

LAYERVERSION_testdistro = "4"
LAYERSERIES_COMPAT_testdistro = "dunfell gatesgarth"

INHERIT += "mender-fixups"

BBFILES_DYNAMIC += " \
    mender:${LAYERDIR}/dynamic-layers/meta-mender-core/recipes*/*/*.bb \
    mender:${LAYERDIR}/dynamic-layers/meta-mender-core/recipes*/*/*.bbappend \
"
```

## layers/meta-testdistro/conf/machine/jetson-tx2-cboot.conf
```bitbake
SECURITY_OPTIONS ?= ":secureboot:signing"
MACHINEOVERRIDES = "jetson-tx2:${MACHINE}${SECURITY_OPTIONS}"
IMAGE_FSTYPES = "tar.gz"
require conf/machine/jetson-tx2.conf
PACKAGE_EXTRA_ARCHS_append = " jetson-tx2"
PREFERRED_PROVIDER_virtual/bootloader = "cboot-prebuilt"
MACHINE_EXTRA_RDEPENDS += "tegra-boot-tools"
SYSTEMD_DEFAULT_TARGET = "finished-booting.target"
KERNEL_ARGS = "console=ttyS0,115200 fbcon=map:0 isolcpus=1,2 loglevel=3 rootflags=rw"
```
